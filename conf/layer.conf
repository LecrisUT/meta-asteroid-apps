## conf/layer.conf
```bitbake
# We have a conf and classes directory, append to BBPATH
BBPATH .= ":${LAYERDIR}"

# We have a recipes directory, add to BBFILES
BBFILES += "${LAYERDIR}/asteroid-*/*.bb ${LAYERDIR}/asteroid-*/*.bbappend"

BBFILE_COLLECTIONS += "asteroid-apps-layer"
BBFILE_PATTERN_asteroid-apps-layer := "^${LAYERDIR}/"
BBFILE_PRIORITY_asteroid-apps-layer = "7"

LAYERSERIES_COMPAT_asteroid-apps-layer = "honister"

PACKAGE_FEED += "gdb strace"
```
